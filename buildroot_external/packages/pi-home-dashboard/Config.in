## buildroot_external/packages/pi-home-dashboard/Config.in
```kconfig
config BR2_PACKAGE_PI_HOME_DASHBOARD
    bool "Dashboard for PI Home OS"
    depends on BR2_PACKAGE_HOST_RUSTC_TARGET_ARCH_SUPPORTS
    help
      Minimal Rust HTTP server to serve sensor data
```

## buildroot_external/packages/pi-home-display/Config.in
```kconfig
config BR2_PACKAGE_PI_HOME_DISPLAY
    bool "pi-home-display"
    select BR2_PACKAGE_SQLITE
    help
      An application that handles multiple display.
```

## buildroot_external/packages/pi-home-lafvin-ui/Config.in
```kconfig
config BR2_PACKAGE_PI_HOME_LAFVIN_UI
    bool "pi-home-lafvin-ui"
    help
      An application that handles LAFVIN DISPLAY.
```

## buildroot_external/packages/pi-home-sensors/Config.in
```kconfig
config BR2_PACKAGE_PI_HOME_SENSORS
    bool "pi-home-sensors"
    select BR2_PACKAGE_SQLITE
    help
      A simple sensor application that uses SQLite to store sensors data.
```

## buildroot_external/packages/rpi_web_app/Config.in
```kconfig
config BR2_PACKAGE_RPI_WEB_APP
    bool "Rust Web Server for RPi Sensors"
    help
      Minimal Rust HTTP server to serve sensor data
```
