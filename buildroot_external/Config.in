## buildroot_external/Config.in
```kconfig
source "$BR2_EXTERNAL_project_customization_PATH/packages/pi-home-sensors/Config.in"
source "$BR2_EXTERNAL_project_customization_PATH/packages/pi-home-dashboard/Config.in"
source "$BR2_EXTERNAL_project_customization_PATH/packages/pi-home-display/Config.in"
source "$BR2_EXTERNAL_project_customization_PATH/packages/pi-home-lafvin-ui/Config.in"
```
